## sdkconfig.defaults
```kconfig
#
# Ultra Low Power (ULP) Co-processor
#
CONFIG_ULP_COPROC_ENABLED=y
# CONFIG_ULP_COPROC_TYPE_FSM is not set
CONFIG_ULP_COPROC_TYPE_RISCV=y
CONFIG_ULP_COPROC_RESERVE_MEM=4096

#
# ULP RISC-V Settings
#
CONFIG_ULP_RISCV_UART_BAUDRATE=9600
CONFIG_ULP_RISCV_I2C_RW_TIMEOUT=500
# end of ULP RISC-V Settings
```
